# IRQScopeAlternatePeripheralFixture register map
File version: 0.1
Small fixture demonstrating explicitly related peripheral views of one address block.
Registers are 32-bit, read-only, no defined reset value unless marked. A register's access mark holds for its fields unless they carry their own. Offsets are from the block's base; lines under a group give offsets from that group; [hi:lo] are bit positions; {n}, {i} and the like mark numbered series; 'fields as' and 'values as' point back to an identical list; <NAME> marks a mode.

## Memory map
0x40020000 PORTA size 0x4 — Digital GPIO view.
0x40020000 PORTA_ANALOG size 0x4 — Alternate analog sampling view of the same address block.

## PORTA — Digital GPIO view.
Base 0x40020000
0x00 DATA rw — Digital pin state.
  [15:0] VALUE
0x00 DATA_ANALOG (alternate view of DATA) — Alternate register interpretation when analog mode is selected.
  [15:0] SAMPLE
0x10 PIN group — Digital-mode pin configuration registers.
  0x00 CONTROL rw
0x10 PIN_ANALOG group (alternate view of PIN) — Alternate analog-mode pin configuration layout.
  0x00 SAMPLE_CONTROL

## PORTA_ANALOG — Alternate analog sampling view of the same address block.
Base 0x40020000; alternate view of PORTA
0x00 SAMPLE — Analog sample value when the pin is in analog mode.
  [15:0] VALUE
